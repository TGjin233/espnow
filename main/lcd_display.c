#include "lcd_display.h"

#include "string.h"
#include "stdio.h"

static const char *TAG = "LCD_DISPLAY";

static esp_lcd_panel_io_handle_t io_handle = NULL;
static esp_lcd_panel_handle_t panel_handle = NULL;
static lcd_context_t lcd_ctx = {
    .width = LCD_H_RES,
    .height = LCD_V_RES,
    .bg_color = LCD_BG_COLOR,
    .text_color = LCD_TEXT_COLOR
};

static uint16_t rgb565(uint8_t r, uint8_t g, uint8_t b) {
    return ((r >> 3) << 11) | ((g >> 2) << 5) | (b >> 3);
}

static const uint8_t font_8x16[][16] = {
    {'0', 0x00, 0x00, 0x7C, 0xC6, 0xCE, 0xD6, 0xD6, 0xD6, 0xCE, 0xC6, 0xC6, 0x7C, 0x00, 0x00, 0x00},
    {'1', 0x00, 0x00, 0x30, 0x70, 0x30, 0x30, 0x30, 0x30, 0x30, 0x30, 0x30, 0xFC, 0x00, 0x00, 0x00},
    {'2', 0x00, 0x00, 0x78, 0xCC, 0xCC, 0x0C, 0x18, 0x30, 0x60, 0xC0, 0xCC, 0x78, 0x00, 0x00, 0x00},
    {'3', 0x00, 0x00, 0x78, 0xCC, 0x0C, 0x0C, 0x38, 0x0C, 0x0C, 0x0C, 0xCC, 0x78, 0x00, 0x00, 0x00},
    {'4', 0x00, 0x00, 0x1C, 0x3C, 0x6C, 0xCC, 0xFE, 0x0C, 0x0C, 0x0C, 0x0C, 0x1E, 0x00, 0x00, 0x00},
    {'5', 0x00, 0x00, 0xFC, 0xC0, 0xC0, 0xC0, 0xF8, 0x0C, 0x0C, 0x0C, 0xCC, 0x78, 0x00, 0x00, 0x00},
    {'6', 0x00, 0x00, 0x38, 0x60, 0xC0, 0xC0, 0xF8, 0xCC, 0xCC, 0xCC, 0xCC, 0x78, 0x00, 0x00, 0x00},
    {'7', 0x00, 0x00, 0xFE, 0x06, 0x0C, 0x18, 0x30, 0x30, 0x30, 0x60, 0x60, 0x60, 0x00, 0x00, 0x00},
    {'8', 0x00, 0x00, 0x78, 0xCC, 0xCC, 0xCC, 0x78, 0xCC, 0xCC, 0xCC, 0xCC, 0x78, 0x00, 0x00, 0x00},
    {'9', 0x00, 0x00, 0x78, 0xCC, 0xCC, 0xCC, 0x7C, 0x18, 0x0C, 0x0C, 0x18, 0x70, 0x00, 0x00, 0x00},
    {'A', 0x00, 0x00, 0x30, 0x78, 0xCC, 0xCC, 0xCC, 0xFC, 0xCC, 0xCC, 0xCC, 0xCC, 0x00, 0x00, 0x00},
    {'B', 0x00, 0x00, 0xF8, 0xCC, 0xCC, 0xCC, 0xF8, 0xCC, 0xCC, 0xCC, 0xCC, 0xF8, 0x00, 0x00, 0x00},
    {'C', 0x00, 0x00, 0x78, 0xCC, 0xC0, 0xC0, 0xC0, 0xC0, 0xC0, 0xC0, 0xCC, 0x78, 0x00, 0x00, 0x00},
    {'D', 0x00, 0x00, 0xF0, 0xD8, 0xCC, 0xCC, 0xCC, 0xCC, 0xCC, 0xCC, 0xD8, 0xF0, 0x00, 0x00, 0x00},
    {'E', 0x00, 0x00, 0xFC, 0xC0, 0xC0, 0xC0, 0xF8, 0xC0, 0xC0, 0xC0, 0xC0, 0xFC, 0x00, 0x00, 0x00},
    {'F', 0x00, 0x00, 0xFC, 0xC0, 0xC0, 0xC0, 0xF8, 0xC0, 0xC0, 0xC0, 0xC0, 0xC0, 0x00, 0x00, 0x00},
    {'G', 0x00, 0x00, 0x78, 0xCC, 0xC0, 0xC0, 0xDC, 0xCC, 0xCC, 0xCC, 0xCC, 0x78, 0x00, 0x00, 0x00},
    {'H', 0x00, 0x00, 0xCC, 0xCC, 0xCC, 0xCC, 0xFC, 0xCC, 0xCC, 0xCC, 0xCC, 0xCC, 0x00, 0x00, 0x00},
    {'I', 0x00, 0x00, 0xFC, 0x30, 0x30, 0x30, 0x30, 0x30, 0x30, 0x30, 0x30, 0xFC, 0x00, 0x00, 0x00},
    {'J', 0x00, 0x00, 0x3E, 0x0C, 0x0C, 0x0C, 0x0C, 0x0C, 0x0C, 0xCC, 0xCC, 0x78, 0x00, 0x00, 0x00},
    {'K', 0x00, 0x00, 0xE6, 0xCC, 0xCC, 0xD8, 0xF0, 0xD8, 0xCC, 0xCC, 0xCC, 0xE6, 0x00, 0x00, 0x00},
    {'L', 0x00, 0x00, 0xC0, 0xC0, 0xC0, 0xC0, 0xC0, 0xC0, 0xC0, 0xC0, 0xC0, 0xFC, 0x00, 0x00, 0x00},
    {'M', 0x00, 0x00, 0xC6, 0xEE, 0xFE, 0xFE, 0xD6, 0xC6, 0xC6, 0xC6, 0xC6, 0xC6, 0x00, 0x00, 0x00},
    {'N', 0x00, 0x00, 0xC6, 0xE6, 0xF6, 0xFE, 0xDE, 0xCE, 0xC6, 0xC6, 0xC6, 0xC6, 0x00, 0x00, 0x00},
    {'O', 0x00, 0x00, 0x78, 0xCC, 0xCC, 0xCC, 0xCC, 0xCC, 0xCC, 0xCC, 0xCC, 0x78, 0x00, 0x00, 0x00},
    {'P', 0x00, 0x00, 0xF8, 0xCC, 0xCC, 0xCC, 0xF8, 0xC0, 0xC0, 0xC0, 0xC0, 0xC0, 0x00, 0x00, 0x00},
    {'Q', 0x00, 0x00, 0x78, 0xCC, 0xCC, 0xCC, 0xCC, 0xCC, 0xDC, 0xD8, 0xCC, 0x76, 0x00, 0x00, 0x00},
    {'R', 0x00, 0x00, 0xF8, 0xCC, 0xCC, 0xCC, 0xF8, 0xD8, 0xCC, 0xCC, 0xCC, 0xE6, 0x00, 0x00, 0x00},
    {'S', 0x00, 0x00, 0x78, 0xCC, 0xC0, 0xC0, 0x78, 0x0C, 0x0C, 0x0C, 0xCC, 0x78, 0x00, 0x00, 0x00},
    {'T', 0x00, 0x00, 0xFC, 0x30, 0x30, 0x30, 0x30, 0x30, 0x30, 0x30, 0x30, 0x30, 0x00, 0x00, 0x00},
    {'U', 0x00, 0x00, 0xCC, 0xCC, 0xCC, 0xCC, 0xCC, 0xCC, 0xCC, 0xCC, 0xCC, 0x78, 0x00, 0x00, 0x00},
    {'V', 0x00, 0x00, 0xCC, 0xCC, 0xCC, 0xCC, 0xCC, 0xCC, 0xCC, 0xCC, 0x78, 0x30, 0x00, 0x00, 0x00},
    {'W', 0x00, 0x00, 0xC6, 0xC6, 0xC6, 0xC6, 0xC6, 0xD6, 0xFE, 0xEE, 0xC6, 0xC6, 0x00, 0x00, 0x00},
    {'X', 0x00, 0x00, 0xC6, 0xC6, 0x6C, 0x38, 0x38, 0x38, 0x6C, 0xC6, 0xC6, 0xC6, 0x00, 0x00, 0x00},
    {'Y', 0x00, 0x00, 0xCC, 0xCC, 0xCC, 0xCC, 0x78, 0x30, 0x30, 0x30, 0x30, 0x30, 0x00, 0x00, 0x00},
    {'Z', 0x00, 0x00, 0xFC, 0x0C, 0x0C, 0x18, 0x30, 0x60, 0xC0, 0xC0, 0xC0, 0xFC, 0x00, 0x00, 0x00},
    {'a', 0x00, 0x00, 0x00, 0x00, 0x00, 0x78, 0x0C, 0x7C, 0xCC, 0xCC, 0xCC, 0x76, 0x00, 0x00, 0x00},
    {'b', 0x00, 0x00, 0xC0, 0xC0, 0xC0, 0xD8, 0xEC, 0xCC, 0xCC, 0xCC, 0xCC, 0xD8, 0x00, 0x00, 0x00},
    {'c', 0x00, 0x00, 0x00, 0x00, 0x00, 0x78, 0xCC, 0xC0, 0xC0, 0xC0, 0xCC, 0x78, 0x00, 0x00, 0x00},
    {'d', 0x00, 0x00, 0x1C, 0x0C, 0x0C, 0x3C, 0x6C, 0xCC, 0xCC, 0xCC, 0xCC, 0x76, 0x00, 0x00, 0x00},
    {'e', 0x00, 0x00, 0x00, 0x00, 0x00, 0x78, 0xCC, 0xCC, 0xFC, 0xC0, 0xCC, 0x78, 0x00, 0x00, 0x00},
    {'f', 0x00, 0x00, 0x38, 0x60, 0xC0, 0xF8, 0xC0, 0xC0, 0xC0, 0xC0, 0xC0, 0xC0, 0x00, 0x00, 0x00},
    {'g', 0x00, 0x00, 0x00, 0x00, 0x00, 0x76, 0xCC, 0xCC, 0xCC, 0x7C, 0x0C, 0xCC, 0x78, 0x00, 0x00},
    {'h', 0x00, 0x00, 0xC0, 0xC0, 0xC0, 0xD8, 0xEC, 0xCC, 0xCC, 0xCC, 0xCC, 0xCC, 0x00, 0x00, 0x00},
    {'i', 0x00, 0x18, 0x18, 0x00, 0x00, 0x38, 0x18, 0x18, 0x18, 0x18, 0x18, 0x3C, 0x00, 0x00, 0x00},
    {'j', 0x00, 0x06, 0x06, 0x00, 0x00, 0x0E, 0x06, 0x06, 0x06, 0x06, 0x06, 0x66, 0x66, 0x3C, 0x00},
    {'k', 0x00, 0x00, 0x00, 0xC0, 0xC0, 0xCC, 0xCC, 0xD8, 0xF0, 0xD8, 0xCC, 0xC6, 0x00, 0x00, 0x00},
    {'l', 0x00, 0x00, 0x38, 0x18, 0x18, 0x18, 0x18, 0x18, 0x18, 0x18, 0x18, 0x3C, 0x00, 0x00, 0x00},
    {'m', 0x00, 0x00, 0x00, 0x00, 0x00, 0xEC, 0xFE, 0xD6, 0xC6, 0xC6, 0xC6, 0xC6, 0x00, 0x00, 0x00},
    {'n', 0x00, 0x00, 0x00, 0x00, 0x00, 0xDC, 0xEC, 0xCC, 0xCC, 0xCC, 0xCC, 0xCC, 0x00, 0x00, 0x00},
    {'o', 0x00, 0x00, 0x00, 0x00, 0x00, 0x78, 0xCC, 0xCC, 0xCC, 0xCC, 0xCC, 0x78, 0x00, 0x00, 0x00},
    {'p', 0x00, 0x00, 0x00, 0x00, 0x00, 0xD8, 0xEC, 0xCC, 0xCC, 0xCC, 0xCC, 0xD8, 0xC0, 0xC0, 0x00},
    {'q', 0x00, 0x00, 0x00, 0x00, 0x00, 0x76, 0xCC, 0xCC, 0xCC, 0xCC, 0xCC, 0x76, 0x0C, 0x0C, 0x00},
    {'r', 0x00, 0x00, 0x00, 0x00, 0x00, 0xEC, 0xDC, 0xC0, 0xC0, 0xC0, 0xC0, 0xC0, 0x00, 0x00, 0x00},
    {'s', 0x00, 0x00, 0x00, 0x00, 0x00, 0x7C, 0xCC, 0xC0, 0x78, 0x0C, 0xCC, 0x78, 0x00, 0x00, 0x00},
    {'t', 0x00, 0x00, 0x30, 0x30, 0x30, 0xFC, 0x30, 0x30, 0x30, 0x30, 0x30, 0x1C, 0x00, 0x00, 0x00},
    {'u', 0x00, 0x00, 0x00, 0x00, 0x00, 0xCC, 0xCC, 0xCC, 0xCC, 0xCC, 0xCC, 0x76, 0x00, 0x00, 0x00},
    {'v', 0x00, 0x00, 0x00, 0x00, 0x00, 0xCC, 0xCC, 0xCC, 0xCC, 0xCC, 0x78, 0x30, 0x00, 0x00, 0x00},
    {'w', 0x00, 0x00, 0x00, 0x00, 0x00, 0xC6, 0xC6, 0xD6, 0xFE, 0xEE, 0xC6, 0xC6, 0x00, 0x00, 0x00},
    {'x', 0x00, 0x00, 0x00, 0x00, 0x00, 0xC6, 0x6C, 0x38, 0x38, 0x6C, 0xC6, 0xC6, 0x00, 0x00, 0x00},
    {'y', 0x00, 0x00, 0x00, 0x00, 0x00, 0x66, 0x66, 0x66, 0x66, 0x66, 0x3C, 0x18, 0x0C, 0x78, 0x00},
    {'z', 0x00, 0x00, 0x00, 0x00, 0x00, 0xFC, 0x0C, 0x18, 0x30, 0x60, 0xC0, 0xFC, 0x00, 0x00, 0x00},
    {':', 0x00, 0x00, 0x00, 0x00, 0x00, 0x18, 0x18, 0x00, 0x00, 0x00, 0x18, 0x18, 0x00, 0x00, 0x00},
    {' ', 0x00, 0x00, 0x00, 0x00, 0x00, 0x00, 0x00, 0x00, 0x00, 0x00, 0x00, 0x00, 0x00, 0x00, 0x00},
    {'.', 0x00, 0x00, 0x00, 0x00, 0x00, 0x00, 0x00, 0x00, 0x00, 0x00, 0x00, 0x18, 0x18, 0x00, 0x00},
    {',', 0x00, 0x00, 0x00, 0x00, 0x00, 0x00, 0x00, 0x00, 0x00, 0x00, 0x18, 0x18, 0x30, 0x00, 0x00},
    {'!', 0x00, 0x18, 0x18, 0x18, 0x18, 0x18, 0x18, 0x18, 0x00, 0x00, 0x18, 0x18, 0x00, 0x00, 0x00},
    {'?', 0x00, 0x00, 0x78, 0xCC, 0x0C, 0x0C, 0x18, 0x18, 0x18, 0x00, 0x18, 0x18, 0x00, 0x00, 0x00},
    {'-', 0x00, 0x00, 0x00, 0x00, 0x00, 0x00, 0x00, 0xFC, 0x00, 0x00, 0x00, 0x00, 0x00, 0x00, 0x00},
    {'+', 0x00, 0x00, 0x00, 0x00, 0x00, 0x30, 0x30, 0xFC, 0x30, 0x30, 0x00, 0x00, 0x00, 0x00, 0x00},
    {'*', 0x00, 0x00, 0x00, 0x00, 0x60, 0xF0, 0x3C, 0x0E, 0x3C, 0xF0, 0x60, 0x00, 0x00, 0x00, 0x00},
    {'/', 0x00, 0x00, 0x00, 0x00, 0x06, 0x0C, 0x18, 0x30, 0x60, 0xC0, 0x80, 0x00, 0x00, 0x00, 0x00},
};

esp_err_t lcd_init(void) {
    ESP_LOGI(TAG, "Initialize SPI bus");
    spi_bus_config_t bus_cfg = {
        .sclk_io_num = LCD_CLK,
        .mosi_io_num = LCD_MOSI,
        .miso_io_num = -1,
        .quadwp_io_num = -1,
        .quadhd_io_num = -1,
        .max_transfer_sz = 0
    };
    ESP_ERROR_CHECK(spi_bus_initialize(LCD_HOST, &bus_cfg, SPI_DMA_CH_AUTO));

    ESP_LOGI(TAG, "Install panel IO");
    esp_lcd_panel_io_spi_config_t io_config = {
        .dc_gpio_num = LCD_DC,
        .cs_gpio_num = LCD_CS,
        .pclk_hz = LCD_PIXEL_CLOCK_HZ,
        .lcd_cmd_bits = 8,
        .lcd_param_bits = 8,
        .spi_mode = 0,
        .trans_queue_depth = 10,
    };
    ESP_ERROR_CHECK(esp_lcd_new_panel_io_spi((esp_lcd_spi_bus_handle_t)LCD_HOST,
                                             &io_config, &io_handle));

    ESP_LOGI(TAG, "Install ST7789 panel driver");
    esp_lcd_panel_dev_config_t panel_config = {
        .reset_gpio_num = LCD_RST,
        .rgb_ele_order = LCD_RGB_ELEMENT_ORDER_RGB,
        .bits_per_pixel = 16,
    };
    ESP_ERROR_CHECK(esp_lcd_new_panel_st7789(io_handle, &panel_config, &panel_handle));

    ESP_ERROR_CHECK(esp_lcd_panel_reset(panel_handle));
    ESP_ERROR_CHECK(esp_lcd_panel_init(panel_handle));
    ESP_ERROR_CHECK(esp_lcd_panel_invert_color(panel_handle, true));
    ESP_ERROR_CHECK(esp_lcd_panel_set_gap(panel_handle, 0, 0));
    ESP_ERROR_CHECK(esp_lcd_panel_disp_on_off(panel_handle, true));
    ESP_ERROR_CHECK(esp_lcd_panel_mirror(panel_handle, true, true));

    ESP_LOGI(TAG, "Initialize backlight GPIO");
    gpio_reset_pin(LCD_BL);
    gpio_set_direction(LCD_BL, GPIO_MODE_OUTPUT);
    gpio_set_level(LCD_BL, 1);

    ESP_LOGI(TAG, "LCD initialized successfully");
    lcd_clear(LCD_BG_COLOR);
    
    return ESP_OK;
}

void lcd_set_backlight(bool on) {
    gpio_set_level(LCD_BL, on ? 1 : 0);
    ESP_LOGI(TAG, "Backlight %s", on ? "ON" : "OFF");
}

void lcd_clear(uint16_t color) {
    lcd_fill_rect(0, 0, LCD_H_RES - 1, LCD_V_RES - 1, color);
}

void lcd_fill_rect(uint16_t x_start, uint16_t y_start, uint16_t x_end, uint16_t y_end, uint16_t color) {
    if (x_end < x_start || y_end < y_start) {
        return;
    }
    x_end = (x_end >= LCD_H_RES) ? LCD_H_RES - 1 : x_end;
    y_end = (y_end >= LCD_V_RES) ? LCD_V_RES - 1 : y_end;
    
    esp_lcd_panel_draw_bitmap(panel_handle, x_start, y_start, x_end + 1, y_end + 1, &color);
}

void lcd_draw_pixel(uint16_t x, uint16_t y, uint16_t color) {
    if (x >= LCD_H_RES || y >= LCD_V_RES) {
        return;
    }
    esp_lcd_panel_draw_bitmap(panel_handle, x, y, x + 1, y + 1, &color);
}

void lcd_draw_rect(uint16_t x_start, uint16_t y_start, uint16_t x_end, uint16_t y_end, uint16_t color) {
    lcd_draw_line(x_start, y_start, x_end, y_start, color);
    lcd_draw_line(x_start, y_end, x_end, y_end, color);
    lcd_draw_line(x_start, y_start, x_start, y_end, color);
    lcd_draw_line(x_end, y_start, x_end, y_end, color);
}

void lcd_draw_line(uint16_t x1, uint16_t y1, uint16_t x2, uint16_t y2, uint16_t color) {
    int16_t dx = abs(x2 - x1);
    int16_t dy = abs(y2 - y1);
    int16_t sx = (x1 < x2) ? 1 : -1;
    int16_t sy = (y1 < y2) ? 1 : -1;
    int16_t err = dx - dy;

    while (1) {
        lcd_draw_pixel(x1, y1, color);
        if (x1 == x2 && y1 == y2) break;
        int16_t e2 = 2 * err;
        if (e2 > -dy) {
            err -= dy;
            x1 += sx;
        }
        if (e2 < dx) {
            err += dx;
            y1 += sy;
        }
    }
}

void lcd_draw_circle(uint16_t x_center, uint16_t y_center, uint16_t radius, uint16_t color) {
    int16_t x = radius;
    int16_t y = 0;
    int16_t err = 0;

    while (x >= y) {
        lcd_draw_pixel(x_center + x, y_center + y, color);
        lcd_draw_pixel(x_center + y, y_center + x, color);
        lcd_draw_pixel(x_center - y, y_center + x, color);
        lcd_draw_pixel(x_center - x, y_center + y, color);
        lcd_draw_pixel(x_center - x, y_center - y, color);
        lcd_draw_pixel(x_center - y, y_center - x, color);
        lcd_draw_pixel(x_center + y, y_center - x, color);
        lcd_draw_pixel(x_center + x, y_center - y, color);

        if (err <= 0) {
            y += 1;
            err += 2 * y + 1;
        }
        if (err > 0) {
            x -= 1;
            err -= 2 * x + 1;
        }
    }
}

void lcd_fill_circle(uint16_t x_center, uint16_t y_center, uint16_t radius, uint16_t color) {
    int16_t x = radius;
    int16_t y = 0;
    int16_t err = 0;

    while (x >= y) {
        lcd_draw_line(x_center - x, y_center + y, x_center + x, y_center + y, color);
        lcd_draw_line(x_center - y, y_center + x, x_center + y, y_center + x, color);
        lcd_draw_line(x_center - y, y_center - x, x_center + y, y_center - x, color);
        lcd_draw_line(x_center - x, y_center - y, x_center + x, y_center - y, color);

        if (err <= 0) {
            y += 1;
            err += 2 * y + 1;
        }
        if (err > 0) {
            x -= 1;
            err -= 2 * x + 1;
        }
    }
}

void lcd_draw_char(uint16_t x, uint16_t y, char ch, uint16_t fg_color, uint16_t bg_color, uint8_t size) {
    if (ch < ' ' || ch > 'z') ch = ' ';
    
    uint8_t char_index = (uint8_t)(ch - ' ');
    uint8_t char_width = 8;
    uint8_t char_height = 16;
    uint16_t color_buf;
    
    for (uint8_t row = 0; row < char_height; row++) {
        uint8_t byte = font_8x16[char_index][row + 1];
        for (uint8_t col = 0; col < char_width; col++) {
            if (byte & (0x80 >> col)) {
                color_buf = fg_color;
            } else {
                color_buf = bg_color;
            }
            for (uint8_t dy = 0; dy < size; dy++) {
                for (uint8_t dx = 0; dx < size; dx++) {
                    lcd_draw_pixel(x + col * size + dx, y + row * size + dy, color_buf);
                }
            }
        }
    }
}

void lcd_draw_string(uint16_t x, uint16_t y, const char *str, uint16_t fg_color, uint16_t bg_color, uint8_t size, lcd_text_align_t align) {
    if (str == NULL || strlen(str) == 0) return;
    
    uint16_t char_width = 8 * size;
    uint16_t total_width = strlen(str) * char_width;
    uint16_t start_x = x;
    
    if (align == LCD_ALIGN_CENTER) {
        start_x = x - total_width / 2;
    } else if (align == LCD_ALIGN_RIGHT) {
        start_x = x - total_width;
    }
    
    uint16_t current_x = start_x;
    while (*str) {
        lcd_draw_char(current_x, y, *str, fg_color, bg_color, size);
        current_x += char_width;
        str++;
    }
}

void lcd_set_bg_color(uint16_t color) {
    lcd_ctx.bg_color = color;
}

void lcd_set_text_color(uint16_t color) {
    lcd_ctx.text_color = color;
}

void lcd_draw_progress_bar(uint16_t x, uint16_t y, uint16_t width, uint16_t height, uint8_t percentage, uint16_t fg_color, uint16_t bg_color) {
    lcd_draw_rect(x, y, x + width, y + height, fg_color);
    uint16_t fill_width = (width - 4) * percentage / 100;
    if (fill_width > 0) {
        lcd_fill_rect(x + 2, y + 2, x + 1 + fill_width, y + height - 2, fg_color);
    }
    uint16_t remaining_width = (width - 4) - fill_width;
    if (remaining_width > 0) {
        lcd_fill_rect(x + 2 + fill_width, y + 2, x + width - 2, y + height - 2, bg_color);
    }
}

void lcd_display_task(void *pvParameter) {
    ESP_LOGI(TAG, "LCD display task started");
    
    while (1) {
        lcd_clear(rgb565(0, 0, 0));
        
        lcd_draw_string(120, 10, "ESP32 ESPNOW", rgb565(255, 255, 255), rgb565(0, 0, 0), 2, LCD_ALIGN_CENTER);
        
        lcd_draw_line(10, 50, 230, 50, rgb565(255, 255, 255));
        
        lcd_draw_string(20, 70, "Temperature:", rgb565(255, 100, 100), rgb565(0, 0, 0), 1, LCD_ALIGN_LEFT);
        lcd_draw_string(200, 70, "25.5 C", rgb565(255, 255, 255), rgb565(0, 0, 0), 1, LCD_ALIGN_RIGHT);
        
        lcd_draw_string(20, 95, "Humidity:", rgb565(100, 200, 255), rgb565(0, 0, 0), 1, LCD_ALIGN_LEFT);
        lcd_draw_string(200, 95, "60.0 %", rgb565(255, 255, 255), rgb565(0, 0, 0), 1, LCD_ALIGN_RIGHT);
        
        lcd_draw_progress_bar(20, 130, 200, 20, 75, rgb565(0, 200, 100), rgb565(50, 50, 50));
        
        lcd_draw_circle(120, 200, 40, rgb565(255, 255, 0));
        lcd_fill_circle(120, 200, 35, rgb565(255, 200, 0));
        
        lcd_draw_rect(20, 260, 220, 300, rgb565(0, 255, 255));
        lcd_draw_string(120, 270, "STATUS: OK", rgb565(0, 255, 255), rgb565(0, 0, 0), 1, LCD_ALIGN_CENTER);
        
        vTaskDelay(pdMS_TO_TICKS(1000));
    }
}
